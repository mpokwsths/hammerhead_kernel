## Documentation/devicetree/bindings/arm/msm/imem.txt
```
Qualcomm IMEM

IMEM is fast on-chip memory used for various debug features and dma transactions.

Required properties

-compatible: "qcom,msm-imem"
-reg: start address and size of imem memory

If any children nodes exist the following properties are required:
-#address-cells: should be 1
-#size-cells: should be 1
-ranges: A triplet that includes the child address, parent address, &
	 length.  The child address is assumed to be 0.

Child nodes:
------------

Peripheral Image Loader (pil):
------------------------------
Required properties:
-compatible: "qcom,msm-imem-pil"
-reg: start address and size of PIL region in imem

Bootloader Stats:
-----------------
Required properties:
-compatible: "qcom,msm-imem-boot_stats"
-reg: start address and size of boot_stats region in imem

Cache error reporting:
-----------------
Required properties:
-compatible: "qcom,msm-imem-cache_erp"
-reg: start address and size of cache_erp region in imem

Example:

	qcom,msm-imem {
		compatible = "qcom,msm-imem";
		reg = <0xdeadbeef 0x1000>; /* < start_address size > */
		ranges = <0x0 0xdeadbeef 0x1000>;
		#address-cells = <1>;
		#size-cells = <1>;

		imem_cache_erp: cache_erp@6a4 {
			compatible = "qcom,msm-imem-cache_erp";
			reg = <0x6a4 4>;
		};

		boot_stats@6b0 {
			compatible = "qcom,msm-imem-boot_stats";
			reg = <0x6b0 32>;
		};

		pil@94c {
			compatible = "qcom,msm-imem-pil";
			reg = <0x94c 200>;
		};
	};
```
